## Documentation/devicetree/bindings/vendor-prefixes.yaml
```yaml
# SPDX-License-Identifier: (GPL-2.0-only OR BSD-2-Clause)
%YAML 1.2
---
$schema: http://json-schema.org/draft-07/schema#

title: Vendor Prefixes
maintainers:
  - Rob Herring <robh@kernel.org>
  - Grant Likely <grant.likely@linaro.org>
description: |
  This is a list of vendor prefixes used in device tree compatible
  strings and properties.  Each vendor prefix must be a unique string
  that identifies the vendor.  The prefix is used to construct the
  compatible string by appending the device name to the prefix.

  For example, a device from Acme Corporation might have a compatible
  string like "acme,widget".  The vendor prefix would be "acme".

  The vendor prefix should be lowercase and use hyphens instead of
  spaces.  It should not contain any other special characters.

  New vendor prefixes should be added in alphabetical order.

type: object
patternProperties:
  "^a10networks,.*":
    description: A10 Networks
  "^a2o,.*":
    description: A2O
  "^a31,.*":
    description: A31
  "^accton,.*":
    description: Accton Technology Corporation
  "^acer,.*":
    description: Acer Inc.
  "^actel,.*":
    description: Actel Corporation
  "^action,.*":
    description: Action Semiconductors
  "^actis,.*":
    description: Actis
  "^adaptive,.*":
    description: Adaptive Computing
  "^adaptec,.*":
    description: Adaptec
  "^advantech,.*":
    description: Advantech
  "^adi,.*":
    description: Analog Devices
  "^adlink,.*":
    description: ADLINK Technology Inc.
  "^advansee,.*":
    description: Advansee
  "^aeon,.*":
    description: Aeon
  "^aeroflex,.*":
    description: Aeroflex
  "^aetina,.*":
    description: Aetina
  "^agere,.*":
    description: Agere Systems
  "^agilent,.*":
    description: Agilent Technologies
  "^ait,.*":
    description: AIT
  "^altera,.*":
    description: Altera
  "^alv,.*":
    description: ALV
  "^amazon,.*":
    description: Amazon
  "^amd,.*":
    description: Advanced Micro Devices
  "^amlogic,.*":
    description: Amlogic
  "^amot,.*":
    description: AMOT
  "^android,.*":
    description: Android
  "^anritsu,.*":
    description: Anritsu
  "^apex,.*":
    description: Apex
  "^apm,.*":
    description: APM
  "^apple,.*":
    description: Apple
  "^aqm,.*":
    description: AQM
  "^arcadyan,.*":
    description: Arcadyan
  "^arctica,.*":
    description: Arctica
  "^arista,.*":
    description: Arista Networks
  "^aristanetworks,.*":
    description: Arista Networks
  "^arm,.*":
    description: ARM
  "^armltd,.*":
    description: ARM Ltd.
  "^aspeed,.*":
    description: ASPEED Technology
  "^asus,.*":
    description: ASUS
  "^asustek,.*":
    description: ASUSTeK Computer Inc.
  "^atmel,.*":
    description: Atmel
  "^atomisp,.*":
    description: Intel Atom ISP
  "^audience,.*":
    description: Audience
  "^autotalks,.*":
    description: Autotalks
  "^avago,.*":
    description: Avago Technologies
  "^availink,.*":
    description: Availink
  "^avaya,.*":
    description: Avaya
  "^avm,.*":
    description: AVM
  "^axentia,.*":
    description: Axentia
  "^axis,.*":
    description: Axis Communications
  "^az,.*":
    description: AZ
  "^azael,.*":
    description: Azael
  "^azurewave,.*":
    description: AzureWave
  "^baldor,.*":
    description: Baldor
  "^baltic,.*":
    description: Baltic
  "^bang-olufsen,.*":
    description: Bang & Olufsen
  "^baxter,.*":
    description: Baxter
  "^baytrail,.*":
    description: Bay Trail
  "^bcm,.*":
    description: Broadcom
  "^beagleboard,.*":
    description: BeagleBoard.org
  "^belkin,.*":
    description: Belkin
  "^benq,.*":
    description: BenQ
  "^bestdata,.*":
    description: Bestdata
  "^blackmagicdesign,.*":
    description: Blackmagic Design
  "^bluetooth,.*":
    description: Bluetooth
  "^bmc,.*":
    description: BMC
  "^bosch,.*":
    description: Bosch
  "^brainboxes,.*":
    description: Brainboxes
  "^broadcom,.*":
    description: Broadcom
  "^brocade,.*":
    description: Brocade
  "^brown,.*":
    description: Brown
  "^bsg,.*":
    description: BSG
  "^btt,.*":
    description: BTT
  "^buffalo,.*":
    description: Buffalo
  "^buslogic,.*":
    description: BusLogic
  "^cambrionix,.*":
    description: Cambrionix
  "^canon,.*":
    description: Canon
  "^cavium,.*":
    description: Cavium
  "^ccs,.*":
    description: CCS
  "^celerity,.*":
    description: Celerity
  "^celestica,.*":
    description: Celestica
  "^centec,.*":
    description: Centec
  "^century,.*":
    description: Century
  "^chicony,.*":
    description: Chicony
  "^chili,.*":
    description: Chili
  "^chipidea,.*":
    description: Chipidea
  "^chips,.*":
    description: CHIPS
  "^cirrus,.*":
    description: Cirrus Logic
  "^cisco,.*":
    description: Cisco Systems
  "^citrix,.*":
    description: Citrix
  "^cloud,.*":
    description: Cloud
  "^cnslink,.*":
    description: CNSLink
  "^cognichip,.*":
    description: Cognichip
  "^colibri,.*":
    description: Colibri
  "^compaq,.*":
    description: Compaq
  "^compal,.*":
    description: Compal
  "^conexant,.*":
    description: Conexant
  "^cornerstone,.*":
    description: Cornerstone
  "^corrigent,.*":
    description: Corrigent
  "^cortina,.*":
    description: Cortina Systems
  "^cray,.*":
    description: Cray
  "^creative,.*":
    description: Creative Labs
  "^crystal,.*":
    description: Crystal
  "^csa,.*":
    description: CSA
  "^curtisswright,.*":
    description: Curtiss-Wright
  "^cyanogen,.*":
    description: Cyanogen
  "^cypress,.*":
    description: Cypress Semiconductor
  "^daheng,.*":
    description: Daheng
  "^davis,.*":
    description: Davis
  "^davinci,.*":
    description: DaVinci
  "^dell,.*":
    description: Dell
  "^delta,.*":
    description: Delta
  "^dfi,.*":
    description: DFI
  "^dgi,.*":
    description: DGI
  "^digium,.*":
    description: Digium
  "^dlink,.*":
    description: D-Link
  "^dlog,.*":
    description: Dlog
  "^dm,.*":
    description: DM
  "^docker,.*":
    description: Docker
  "^dolphin,.*":
    description: Dolphin
  "^dynamix,.*":
    description: Dynamix
  "^e2v,.*":
    description: e2v
  "^easics,.*":
    description: Easics
  "^edimax,.*":
    description: Edimax
  "^efm32,.*":
    description: EFM32
  "^eigencomm,.*":
    description: Eigencomm
  "^elexol,.*":
    description: Elexol
  "^embest,.*":
    description: Embest
  "^emc,.*":
    description: EMC
  "^emcraft,.*":
    description: EMCraft
  "^emerson,.*":
    description: Emerson
  "^emmc,.*":
    description: eMMC
  "^empia,.*":
    description: Empia
  "^encirc,.*":
    description: Encirc
  "^energid,.*":
    description: Energid
  "^enodo,.*":
    description: Enodo
  "^entropic,.*":
    description: Entropic
  "^epc,.*":
    description: EPC
  "^equuleus,.*":
    description: Equuleus
  "^ericsson,.*":
    description: Ericsson
  "^es,.*":
    description: ES
  "^espressif,.*":
    description: Espressif
  "^etron,.*":
    description: Etron
  "^evga,.*":
    description: EVGA
  "^evolution,.*":
    description: Evolution
  "^exar,.*":
    description: Exar
  "^exynos,.*":
    description: Exynos
  "^farsight,.*":
    description: Farsight
  "^fastek,.*":
    description: Fastek
  "^fcs,.*":
    description: FCS
  "^feasycom,.*":
    description: Feasycom
  "^feng,.*":
    description: Feng
  "^fermium,.*":
    description: Fermium
  "^fico,.*":
    description: FICO
  "^fidus,.*":
    description: Fidus
  "^firefly,.*":
    description: Firefly
  "^flex,.*":
    description: Flex
  "^focaltech,.*":
    description: FocalTech
  "^forlinx,.*":
    description: Forlinx
  "^foxconn,.*":
    description: Foxconn
  "^freescale,.*":
    description: Freescale
  "^fujitsu,.*":
    description: Fujitsu
  "^fujitsu-siemens,.*":
    description: Fujitsu Siemens
  "^garmin,.*":
    description: Garmin
  "^gct,.*":
    description: GCT
  "^gemalto,.*":
    description: Gemalto
  "^geniatech,.*":
    description: Geniatech
  "^geode,.*":
    description: Geode
  "^getac,.*":
    description: Getac
  "^giantec,.*":
    description: Giantec
  "^gigabyte,.*":
    description: Gigabyte
  "^gigabytemotherboard,.*":
    description: Gigabyte Motherboard
  "^gigabyte,.*":
    description: Gigabyte
  "^google,.*":
    description: Google
  "^gotech,.*":
    description: Gotech
  "^grandstream,.*":
    description: Grandstream
  "^gree,.*":
    description: Gree
  "^griffin,.*":
    description: Griffin
  "^gtk,.*":
    description: GTK
  "^guangzhou,.*":
    description: Guangzhou
  "^hantronix,.*":
    description: Hantronix
  "^harman,.*":
    description: Harman
  "^havit,.*":
    description: Havit
  "^hawking,.*":
    description: Hawking
  "^hct,.*":
    description: HCT
  "^hetzner,.*":
    description: Hetzner
  "^hfeasy,.*":
    description: HFeasy
  "^hifn,.*":
    description: HIFn
  "^hikvision,.*":
    description: Hikvision
  "^hisi,.*":
    description: HiSilicon
  "^holtek,.*":
    description: Holtek
  "^horizon,.*":
    description: Horizon
  "^hp,.*":
    description: HP
  "^htc,.*":
    description: HTC
  "^huawei,.*":
    description: Huawei
  "^hynix,.*":
    description: Hynix
  "^ibm,.*":
    description: IBM
  "^icplus,.*":
    description: IC Plus
  "^ict,.*":
    description: ICT
  "^ikea,.*":
    description: IKEA
  "^imagination,.*":
    description: Imagination Technologies
  "^inel,.*":
    description: INEL
  "^infinera,.*":
    description: Infinera
  "^ingrasys,.*":
    description: Ingrasys
  "^inhand,.*":
    description: InHand
  "^ini,.*":
    description: INI
  "^innofidei,.*":
    description: Innofidei
  "^innos,.*":
    description: Innos
  "^inspur,.*":
    description: Inspur
  "^intel,.*":
    description: Intel
  "^inventec,.*":
    description: Inventec
  "^invensense,.*":
    description: InvenSense
  "^invision,.*":
    description: InVision
  "^iot,.*":
    description: IoT
  "^ipwireless,.*":
    description: IPWireless
  "^iqr,.*":
    description: IQR
  "^irf,.*":
    description: IRF
  "^iridium,.*":
    description: Iridium
  "^ism,.*":
    description: ISM
  "^itri,.*":
    description: ITRI
  "^jabil,.*":
    description: Jabil
  "^jmicron,.*":
    description: JMicron
  "^johnson,.*":
    description: Johnson
  "^jump,.*":
    description: Jump
  "^kalray,.*":
    description: Kalray
  "^kbc,.*":
    description: KBC
  "^keil,.*":
    description: Keil
  "^kemper,.*":
    description: Kemper
  "^keystone,.*":
    description: Keystone
  "^keysight,.*":
    description: Keysight
  "^keyssa,.*":
    description: Keyssa
  "^keytweak,.*":
    description: Keytweak
  "^kingston,.*":
    description: Kingston
  "^kioxia,.*":
    description: Kioxia
  "^kontron,.*":
    description: Kontron
  "^korg,.*":
    description: Korg
  "^kurtz,.*":
    description: Kurtz
  "^kworld,.*":
    description: KWorld
  "^laird,.*":
    description: Laird
  "^lantiq,.*":
    description: Lantiq
  "^laritan,.*":
    description: LariTan
  "^lcsi,.*":
    description: LCSI
  "^ldo,.*":
    description: LDO
  "^lexmark,.*":
    description: Lexmark
  "^lg,.*":
    description: LG
  "^linaro,.*":
    description: Linaro
  "^lion,.*":
    description: Lion
  "^linksys,.*":
    description: Linksys
  "^liteon,.*":
    description: Liteon
  "^linutop,.*":
    description: Linutop
  "^logicpd,.*":
    description: LogicPD
  "^lorem,.*":
    description: Lorem
  "^lsi,.*":
    description: LSI
  "^lumileds,.*":
    description: Lumileds
  "^luxoft,.*":
    description: Luxoft
  "^luxshare,.*":
    description: Luxshare
  "^lyw,.*":
    description: LYW
  "^ma,.*":
    description: MA
  "^mackerel,.*":
    description: Mackerel
  "^mag,.*":
    description: MAG
  "^mahindra,.*":
    description: Mahindra
  "^marvell,.*":
    description: Marvell
  "^matrox,.*":
    description: Matrox
  "^maxim,.*":
    description: Maxim
  "^maxlinear,.*":
    description: MaxLinear
  "^mecz,.*":
    description: MECZ
  "^mediatek,.*":
    description: MediaTek
  "^melexis,.*":
    description: Melexis
  "^memec,.*":
    description: MEMEC
  "^mentor,.*":
    description: Mentor
  "^meson,.*":
    description: Meson
  "^microchip,.*":
    description: Microchip
  "^micrel,.*":
    description: Micrel
  "^micron,.*":
    description: Micron
  "^microsoft,.*":
    description: Microsoft
  "^mi,.*":
    description: MI
  "^mira,.*":
    description: Mira
  "^moxa,.*":
    description: Moxa
  "^mtk,.*":
    description: MediaTek
  "^musepack,.*":
    description: MusePack
  "^mycron,.*":
    description: MyCron
  "^myriadrf,.*":
    description: MyriadRF
  "^nanya,.*":
    description: Nanya
  "^nas,.*":
    description: NAS
  "^ncsi,.*":
    description: NCSI
  "^nebulent,.*":
    description: Nebulent
  "^neousys,.*":
    description: Neousys
  "^netgear,.*":
    description: Netgear
  "^netlogic,.*":
    description: NetLogic
  "^netronome,.*":
    description: Netronome
  "^nintendo,.*":
    description: Nintendo
  "^nitrokey,.*":
    description: Nitrokey
  "^nokia,.*":
    description: Nokia
  "^norelsys,.*":
    description: Norelsys
  "^noritake,.*":
    description: Noritake
  "^nuvoton,.*":
    description: Nuvoton
  "^nxp,.*":
    description: NXP
  "^oak,.*":
    description: Oak
  "^octeon,.*":
    description: Octeon
  "^omni,.*":
    description: Omni
  "^omnivision,.*":
    description: OmniVision
  "^on,.*":
    description: ON
  "^onion,.*":
    description: Onion
  "^onsemi,.*":
    description: ON Semiconductor
  "^opencores,.*":
    description: OpenCores
  "^opera,.*":
    description: Opera
  "^opencpi,.*":
    description: OpenCPI
  "^oppo,.*":
    description: OPPO
  "^oracle,.*":
    description: Oracle
  "^origins,.*":
    description: Origins
  "^ott,.*":
    description: OTT
  "^ouya,.*":
    description: OUYA
  "^pag,.*":
    description: PAG
  "^panasonic,.*":
    description: Panasonic
  "^paragon,.*":
    description: Paragon
  "^parrot,.*":
    description: Parrot
  "^pcengines,.*":
    description: PC Engines
  "^pegatron,.*":
    description: Pegatron
  "^pericom,.*":
    description: Pericom
  "^phytec,.*":
    description: PHYTEC
  "^pico,.*":
    description: Pico
  "^pine64,.*":
    description: Pine64
  "^pivot,.*":
    description: Pivot
  "^plasmon,.*":
    description: Plasmon
  "^planex,.*":
    description: Planex
  "^polycom,.*":
    description: Polycom
  "^powerwave,.*":
    description: Powerwave
  "^preliminary,.*":
    description: Preliminary
  "^preliminary-products,.*":
    description: Preliminary Products
  "^prizm,.*":
    description: Prizm
  "^prodrive,.*":
    description: Prodrive
  "^profusion,.*":
    description: Profusion
  "^proxim,.*":
    description: Proxim
  "^psion,.*":
    description: Psion
  "^qca,.*":
    description: Qualcomm Atheros
  "^qlogic,.*":
    description: QLogic
  "^qualcomm,.*":
    description: Qualcomm
  "^quantenna,.*":
    description: Quantenna
  "^quark,.*":
    description: Quark
  "^quantum,.*":
    description: Quantum
  "^qnap,.*":
    description: QNAP
  "^qorvo,.*":
    description: Qorvo
  "^racon,.*":
    description: Racon
  "^radiant,.*":
    description: Radiant
  "^raspberrypi,.*":
    description: Raspberry Pi
  "^raystar,.*":
    description: Raystar
  "^raytheon,.*":
    description: Raytheon
  "^realtek,.*":
    description: Realtek
  "^redpine,.*":
    description: Redpine
  "^reolink,.*":
    description: Reolink
  "^renesas,.*":
    description: Renesas
  "^ricoh,.*":
    description: Ricoh
  "^richwave,.*":
    description: Richwave
  "^rockchip,.*":
    description: Rockchip
  "^rohm,.*":
    description: Rohm
  "^roster,.*":
    description: Roster
  "^s3c,.*":
    description: Samsung S3C
  "^saicmotor,.*":
    description: SAIC Motor
  "^sager,.*":
    description: Sager
  "^samknow,.*":
    description: SamKnow
  "^samsung,.*":
    description: Samsung
  "^sandisk,.*":
    description: SanDisk
  "^sanyo,.*":
    description: Sanyo
  "^sap,.*":
    description: SAP
  "^sata,.*":
    description: SATA
  "^scio,.*":
    description: Scio
  "^se,.*":
    description: SE
  "^seagate,.*":
    description: Seagate
  "^seco,.*":
    description: SECO
  "^seeed,.*":
    description: Seeed
  "^segger,.*":
    description: Segger
  "^senao,.*":
    description: Senao
  "^seiko,.*":
    description: Seiko
  "^sel,.*":
    description: SEL
  "^sennheiser,.*":
    description: Sennheiser
  "^semtech,.*":
    description: Semtech
  "^seq,.*":
    description: SEQ
  "^sgi,.*":
    description: SGI
  "^sh,.*":
    description: SH
  "^shuttle,.*":
    description: Shuttle
  "^siemens,.*":
    description: Siemens
  "^sifive,.*":
    description: SiFive
  "^silabs,.*":
    description: Silicon Labs
  "^silex,.*":
    description: Silex
  "^siliconmotion,.*":
    description: Silicon Motion
  "^simmtronics,.*":
    description: Simmtronics
  "^sino,.*":
    description: Sino
  "^sios,.*":
    description: SIOS
  "^smsc,.*":
    description: SMSC
  "^solidrun,.*":
    description: SolidRun
  "^sony,.*":
    description: Sony
  "^sophos,.*":
    description: Sophos
  "^spacemit,.*":
    description: Spacemit
  "^spansion,.*":
    description: Spansion
  "^spectra,.*":
    description: Spectra
  "^spectrum,.*":
    description: Spectrum
  "^spirent,.*":
    description: Spirent
  "^spl,.*":
    description: SPL
  "^spreadtrum,.*":
    description: Spreadtrum
  "^square,.*":
    description: Square
  "^st,.*":
    description: ST
  "^star,.*":
    description: Star
  "^stm,.*":
    description: STM
  "^stmicro,.*":
    description: STMicroelectronics
  "^stratus,.*":
    description: Stratus
  "^sunplus,.*":
    description: Sunplus
  "^sunxi,.*":
    description: Sunxi
  "^supermicro,.*":
    description: Supermicro
  "^swissbit,.*":
    description: Swissbit
  "^synaptics,.*":
    description: Synaptics
  "^synopsys,.*":
    description: Synopsys
  "^sysgo,.*":
    description: Sysgo
  "^systembase,.*":
    description: SystemBase
  "^tattile,.*":
    description: Tattile
  "^tcl,.*":
    description: TCL
  "^technologic,.*":
    description: Technologic
  "^telechips,.*":
    description: Telechips
  "^telit,.*":
    description: Telit
  "^terasic,.*":
    description: Terasic
  "^testo,.*":
    description: Testo
  "^texas,.*":
    description: Texas Instruments
  "^thine,.*":
    description: Thine
  "^thomson,.*":
    description: Thomson
  "^ti,.*":
    description: Texas Instruments
  "^tibbo,.*":
    description: Tibbo
  "^tieto,.*":
    description: Tieto
  "^tnt,.*":
    description: TNT
  "^tokai,.*":
    description: Tokai
  "^toshiba,.*":
    description: Toshiba
  "^tp-link,.*":
    description: TP-Link
  "^tpvision,.*":
    description: TP Vision
  "^trend,.*":
    description: Trend
  "^trendnet,.*":
    description: Trendnet
  "^trickey,.*":
    description: Trickey
  "^tsinghua,.*":
    description: Tsinghua
  "^ttl,.*":
    description: TTL
  "^turbosight,.*":
    description: TurboSight
  "^tylt,.*":
    description: TYLT
  "^ubiquiti,.*":
    description: Ubiquiti
  "^ufi,.*":
    description: UFI
  "^ultrahaptics,.*":
    description: Ultrahaptics
  "^unigen,.*":
    description: Unigen
  "^up,.*":
    description: UP
  "^upboard,.*":
    description: UpBoard
  "^uptech,.*":
    description: UpTech
  "^usrobotics,.*":
    description: US Robotics
  "^vanilla,.*":
    description: Vanilla
  "^veeam,.*":
    description: Veeam
  "^vela,.*":
    description: Vela
  "^verisilicon,.*":
    description: VeriSilicon
  "^viewsonic,.*":
    description: ViewSonic
  "^vishay,.*":
    description: Vishay
  "^vitesse,.*":
    description: Vitesse
  "^vivante,.*":
    description: Vivante
  "^vivobook,.*":
    description: VivoBook
  "^vmware,.*":
    description: VMware
  "^vn,.*":
    description: VN
  "^vtech,.*":
    description: VTech
  "^wacom,.*":
    description: Wacom
  "^wd,.*":
    description: WD
  "^webgate,.*":
    description: WebGate
  "^weibu,.*":
    description: Weibu
  "^western,.*":
    description: Western
  "^wibrain,.*":
    description: Wibrain
  "^winsonic,.*":
    description: Winsonic
  "^wistron,.*":
    description: Wistron
  "^wistronits,.*":
    description: Wistron ITS
  "^wits,.*":
    description: WITS
  "^wistronneweb,.*":
    description: Wistron NeWeb
  "^wolfson,.*":
    description: Wolfson
  "^wondermedia,.*":
    description: WonderMedia
  "^wpi,.*":
    description: WPI
  "^wyle,.*":
    description: Wyle
  "^x10,.*":
    description: X10
  "^xiaomi,.*":
    description: Xiaomi
  "^xilinx,.*":
    description: Xilinx
  "^xilinxsoc,.*":
    description: Xilinx SoC
  "^xio,.*":
    description: XIO
  "^xircom,.*":
    description: Xircom
  "^xmos,.*":
    description: XMOS
  "^xmt,.*":
    description: XMT
  "^xox,.*":
    description: XOX
  "^xunlong,.*":
    description: Shenzhen Xunlong Software CO.,Limited
  "^xylon,.*":
    description: Xylon
  "^yna,.*":
    description: YSH & ATIL
  "^yones-toptech,.*":
    description: Yones Toptech Co., Ltd.
  "^ysoft,.*":
    description: Ysoft
  "^yubico,.*":
    description: Yubico
  "^zebra,.*":
    description: Zebra
  "^zhaoxin,.*":
    description: Zhaoxin
  "^zlg,.*":
    description: ZLG
  "^zotac,.*":
    description: Zotac
  "^zte,.*":
    description: ZTE
  "^zyxel,.*":
    description: ZyXEL
additionalProperties: false
```
