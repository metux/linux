## drivers/input/touchscreen/focaltech_touch/Kconfig
```kconfig
#
# Focaltech Touchscreen driver configuration
#

config TOUCHSCREEN_FTS
    bool "Focaltech Touchscreen"
    default n
    help
      Say Y here if you have Focaltech touch panel.
      If unsure, say N.

config TOUCHSCREEN_FTS_X_REVERSE
    bool "Focaltech Touchscreen X reverse"
    default n
    help
      Say Y here Support Focaltech Touchscreen X reverse.
      If unsure, say N.

config TOUCHSCREEN_FTS_Y_REVERSE
    bool "Focaltech Touchscreen Y reverse"
    default n
    help
      Say Y here Support Focaltech Touchscreen Y reverse.
      If unsure, say N.

config TOUCHSCREEN_FTS_PEN
    bool "Focaltech Touchscreen Pen"
    default n
    help
      Say Y here Support Focaltech Touchscreen Pen.
      If unsure, say N.

config TOUCHSCREEN_FTS_GLOVE
    bool "Focaltech Touchscreen GLOVE"
    default n
    help
      Say Y here Support Focaltech Touchscreen Pen.
      If unsure, say N.
```

## drivers/input/touchscreen/gt9xx_goodix/Kconfig
```kconfig
#
# Goodix GT9xx Touchscreen driver
#
config TOUCHSCREEN_GT9XX
	tristate "Goodix touchpanel GT9xx series"
	help
	  Say Y here if you have a Goodix GT9xx touchscreen
	  controller.
```

## drivers/input/touchscreen/jdchipset/Kconfig
```kconfig
#
# Jadard Touchscreen driver configuration
#

config TOUCHSCREEN_JADARD_MODULE
	tristate "Jadard chipset module fuction"
	help
	  This switch whether to compile into a kernel module.

config TOUCHSCREEN_JDCHIPSET_X_REVERSE
    bool "JDTECH jd9366 X reverse"
    default n
    help
        This enables support for jd9366 driver coor x reverse.

config TOUCHSCREEN_JDCHIPSET_Y_REVERSE
    bool "JDTECH jd9366 Y reverse"
    default n
    help
        This enables support for jd9366 driver coor Y reverse.
```

## drivers/input/touchscreen/mediatek/ILITEK_V3/Kconfig
```kconfig
config TOUCHSCREEN_ILITEK_V3
	tristate "ILITEK_V3 touchscreen"
	help
	  Say Y here if you have the ILITEK_V3 touchscreen 
	  To compile this driver as a module, choose M here: the
	  module will be called ILITEK_V3.
```

## drivers/input/touchscreen/mediatek/Kconfig
```kconfig
#source "drivers/input/touchscreen/mediatek/hxchipset_spi/Kconfig"
source "drivers/input/touchscreen/mediatek/NT36XXX_SPI/Kconfig"
source "drivers/input/touchscreen/mediatek/gslX680/Kconfig"
source "drivers/input/touchscreen/mediatek/nt36xxx_i2c/Kconfig"
source "drivers/input/touchscreen/mediatek/chipone_tddi/Kconfig"
source "drivers/input/touchscreen/mediatek/ILITEK_V3/Kconfig"
source "drivers/input/touchscreen/mediatek/chipone_tddi_i2c/Kconfig"
source "drivers/input/touchscreen/mediatek/focaltech_touch_i2c_v42/Kconfig"
source "drivers/input/touchscreen/mediatek/focaltech_touch_8205p/Kconfig"
source "drivers/input/touchscreen/mediatek/GT9XX/Kconfig"
source "drivers/input/touchscreen/mediatek/huion_i2c/Kconfig"
source "drivers/input/touchscreen/mediatek/jdchipset_spi/Kconfig"
source "drivers/input/touchscreen/mediatek/focaltech_touch_5726/Kconfig"
source "drivers/input/touchscreen/mediatek/chsc5xxx/Kconfig"
#source "drivers/input/touchscreen/mediatek/hxchipset_83102_iic_1186/Kconfig"
```

## drivers/input/touchscreen/mediatek/NT36XXX_SPI/Kconfig
```kconfig
#
# Novatek NT36xxx touchscreen driver configuration
#
config TOUCHSCREEN_NT36xxx_HOSTDL_SPI
	tristate "Novatek NT36xxx host download SPI driver"
	default y
	help
	  Say Y here if you have a Novatek NT36xxx no flash touchscreen connected
	  to your system by SPI bus.

	  If unsure, say N.

config TOUCHSCREEN_NT36xxx_SPI_X_REVERSE
	bool "NT36xxx driver coor x reverse"
	depends on TOUCHSCREEN_NT36xxx_HOSTDL_SPI
	help
	  This enables support for NT36xxx driver coor x reverse.

config TOUCHSCREEN_NT36xxx_SPI_Y_REVERSE
	bool "NT36xxx driver coor y reverse"
	depends on TOUCHSCREEN_NT36xxx_HOSTDL_SPI
	help
	  This enables support for NT36xxx driver coor y reverse.
```

## drivers/input/touchscreen/mediatek/chipone_tddi_i2c/Kconfig
```kconfig
config TOUCHSCREEN_CHIPONE_I2C
	tristate "Chipone TDDI I2C touchscreen for Mediatek package"
	default n
	help
	  Say y here if you have chipone TDDI touch panel.
	  If unsure, say N.
```

## drivers/input/touchscreen/mediatek/focaltech_touch_8205p/Kconfig
```kconfig
#
# Focaltech Touchscreen driver configuration
#

config TOUCHSCREEN_FTS_SPI_8205P
    tristate "Focaltech spi 8205p Touchscreen"
    default n
    help
      Say Y here if you have Focaltech touch panel.
      If unsure, say N.
config TOUCHSCREEN_FTS_X_REVERSE
    bool "Focaltech Touchscreen X reverse"
    default n
    help
      Say Y here Support Focaltech Touchscreen X reverse.
      If unsure, say N.

config TOUCHSCREEN_FTS_Y_REVERSE
    bool "Focaltech Touchscreen Y reverse"
    default n
    help
      Say Y here Support Focaltech Touchscreen Y reverse.
      If unsure, say N.

config TOUCHSCREEN_FTS_PEN_X_REVERSE
    bool "Focaltech Touchscreen X reverse"
    default n
    help
      Say Y here Support Focaltech Touchscreen X reverse.
      If unsure, say N.

config TOUCHSCREEN_FTS_PEN_Y_REVERSE
    bool "Focaltech Touchscreen Y reverse"
    default n
    help
      Say Y here Support Focaltech Touchscreen Y reverse.
      If unsure, say N.
```

## drivers/input/touchscreen/mediatek/focaltech_touch_i2c_v42/Kconfig
```kconfig
#
# Focaltech Touchscreen driver configuration
#

config TOUCHSCREEN_FTS_I2C_V42
    tristate "Focaltech Touchscreen"
    default n
    help
      Say Y here if you have Focaltech touch panel.
      If unsure, say N.

config TOUCHSCREEN_FTS_PEN
    bool "Focaltech Touchscreen Pen"
    default n
    help
      Say Y here Support Focaltech Touchscreen Pen.
      If unsure, say N.

config TOUCHSCREEN_FTS_GLOVE
    bool "Focaltech Touchscreen GLOVE"
    default n
    help
      Say Y here Support Focaltech Touchscreen Pen.
      If unsure, say N.

config TOUCHSCREEN_FTS_AUTO_UPGRADE_EN
    bool "Focaltech Touchscreen auto upgrade"
    default n
    help
      Say Y here Support Focaltech auto upgrade.
      If unsure, say N.
```

## drivers/input/touchscreen/mediatek/focaltech_touch_spi/Kconfig
```kconfig
#
# Focaltech Touchscreen driver configuration
#

config TOUCHSCREEN_FTS_SPI
    tristate "Focaltech chipset SPI touchscreen"
    default n
    help
      Say Y here if you have Focaltech touch panel.
      If unsure, say N.
      
config TOUCHSCREEN_FTS_X_REVERSE
    bool "Focaltech Touchscreen X reverse"
    default n
    help
      Say Y here Support Focaltech Touchscreen X reverse.
      If unsure, say N.

config TOUCHSCREEN_FTS_Y_REVERSE
    bool "Focaltech Touchscreen Y reverse"
    default n
    help
      Say Y here Support Focaltech Touchscreen Y reverse.
      If unsure, say N.
```

## drivers/input/touchscreen/mediatek/gslX680/Kconfig
```kconfig
config TOUCHSCREEN_MTK_GSLX680
	tristate "GSLX680 I2C touchscreen"
	help
	  Say Y here if you have the GSLX680 touchscreen 
	  To compile this driver as a module, choose M here: the
	  module will be called GSLX680.

config TOUCHSCREEN_MTK_GSLX680_TPGESTURE
	bool "gslX680 for Mediatek package gseture"
	help
	  Say Y here if you have gslX680 touch panel.

	  If unsure, say N.
```

## drivers/input/touchscreen/mediatek/huion_i2c/Kconfig
```kconfig
#
# Touchscreen driver configuration
#

config TOUCHSCREEN_HUION_PANELS
	tristate "HUION I2C touchscreen"
	help
	  Say Y here if you have the HUION touchscreen
	  If unsure, say N.

	  To compile this driver as a module, choose M here: the
	  module will be called HUION.

menuconfig TOUCHSCREEN_HUION_PANELS
	bool "Support for huion Panels"

if TOUCHSCREEN_HUION_PANELS

config TOUCHSCREEN_GT9XX
	tristate "huion touchscreen driver"
	depends on I2C
	default n
	help
	  Say Y here if you have the HUION touchscreen.

	  If unsure, say N.

choice
prompt "Select Touch Protocol"
depends on TOUCHSCREEN_GT9XX
default TOUCHSCREEN_PROT_SINGLE

config TOUCHSCREEN_PROT_MT_SYNC
	bool "Multi-touch Protocol A"
	help
	  This enables the stateless type A protocol for QT + tslib.

config TOUCHSCREEN_PROT_MT_SLOT
	bool "Multi-touch Protocol B"
	help
	  This enables the stateful type B slot protocol for Android.

config TOUCHSCREEN_PROT_SINGLE
	bool "Single-touch Protocol"
	help
	  This disables multi-touch mode for Debian (xserver-xorg-input-evdev).

endchoice

endif
```

## drivers/input/touchscreen/mediatek/hxchipset_83122/Kconfig
```kconfig
#
# Himax Touchscreen driver configuration
#

config TOUCHSCREEN_HIMAX_CHIPSET_83122
        tristate "HIMAX chipset SPI touchscreen"
		help
		This enables support for HIMAX CHIPSET touchscreens.
		
config TOUCHSCREEN_HIMAX_BOOT_UPGRADE
        tristate "HIMAX chipset has flash need update"
		help
		This enables support for HIMAX CHIPSET touchscreens.

config TOUCHSCREEN_HIMAX_ZERO_FLASH
        tristate "HIMAX chipset NO FLASH need open"
		help
		This enables support for HIMAX CHIPSET touchscreens.

config TOUCHSCREEN_HIMAX_COMMON
        tristate "HIMAX chipset touchscreen"
		depends on TOUCHSCREEN_HIMAX_CHIPSET_83122
		help
		This enables support for HIMAX CHIPSET touchscreens.

config TOUCHSCREEN_HIMAX_IC_HX83108A
        tristate "HIMAX chipset HX83108A function"
		depends on TOUCHSCREEN_HIMAX_CHIPSET_83122
		help
		This enables support for HIMAX CHIPSET of HX83108A.

config TOUCHSCREEN_HIMAX_IC_HX83102J
        tristate "HIMAX chipset HX83102J function"
		depends on TOUCHSCREEN_HIMAX_CHIPSET_83122
		help
		This enables support for HIMAX CHIPSET of HX83102J.

config TOUCHSCREEN_HIMAX_IC_HX83122A
        bool "HIMAX chipset HX83122A function"
		depends on TOUCHSCREEN_HIMAX_CHIPSET_83122
		help
		This enables support for HIMAX CHIPSET of HX83122A.

config TOUCHSCREEN_HIMAX_IC_HX8530K
        tristate "HIMAX chipset HX8530K function"
		depends on TOUCHSCREEN_HIMAX_CHIPSET_83122
		help
		This enables support for HIMAX CHIPSET of HX8530K.

config TOUCHSCREEN_HIMAX_DEBUG
        bool "HIMAX debug function"
		depends on TOUCHSCREEN_HIMAX_CHIPSET_83122
		help
		This enables support for HIMAX debug function.
config TOUCHSCREEN_HIMAX_INSPECT
        bool "HIMAX inspect function"
		depends on TOUCHSCREEN_HIMAX_CHIPSET_83122
		help
		This enables support for HIMAX inspect function.

config TOUCHSCREEN_HIMAX_EMBEDDED_FIRMWARE
	bool "HIMAX embedded firmware function"
		depends on TOUCHSCREEN_HIMAX_CHIPSET_83122
		help
		This enables built-in FW inside kernel as binary array

config HMX_DB
	bool "HIMAX driver test over Dragon Board"
	depends on TOUCHSCREEN_HIMAX_CHIPSET_83122
	help
	  This enables support for HIMAX driver test over Dragon Board.

config HIMAX_SUPPORT_KERNEL_419
        bool "HIMAX support kernel 4.19"
		depends on TOUCHSCREEN_HIMAX_CHIPSET_83122
		help
		This enables support for support kernel 4.19.

config TOUCHSCREEN_HIMAX_X_REVERSE
	bool "HIMAX driver coor x reverse"
	depends on TOUCHSCREEN_HIMAX_COMMON
	help
	  This enables support for HIMAX driver coor x reverse.

config TOUCHSCREEN_HIMAX_Y_REVERSE
	bool "HIMAX driver coor y reverse"
	depends on TOUCHSCREEN_HIMAX_COMMON
	help
	  This enables support for HIMAX driver coor y reverse.
```

## drivers/input/touchscreen/mediatek/jdchipset_spi/Kconfig
```kconfig
#
# Jadard SPI Touchscreen driver configuration
#

config TOUCHSCREEN_JADARD_SPI_MODULE
    tristate "Jadard SPI touchscreen"
    default n
    help
      Say Y here if you have Jadard SPI touch panel.
      If unsure, say N.
      
config TOUCHSCREEN_JADARD_SPI_MODULE_X_REVERSE
    bool "Jadard SPI Touchscreen X reverse"
    default n
    help
      Say Y here Support Jadard SPI Touchscreen X reverse.
      If unsure, say N.

config TOUCHSCREEN_JADARD_SPI_MODULE_Y_REVERSE
    bool "Jadard SPI Touchscreen Y reverse"
    default n
    help
      Say Y here Support Jadard SPI Touchscreen Y reverse.
      If unsure, say N.
```

## drivers/input/touchscreen/mediatek/nt36xxx_i2c/Kconfig
```kconfig
#
# Novatek NT36xxx touchscreen driver configuration
#

config TOUCHSCREEN_MTK_NT36xxx
	tristate "Novatek NT36xxx"
	default y
	help
	  Say Y here if you have a Novatek NT36xxx touchscreen connected
	  to your system.

	  If unsure, say N.

config TOUCHSCREEN_MTK_NT36xxx_X_REVERSE
	bool "NT36xxx driver coor x reverse"
	depends on TOUCHSCREEN_MTK_NT36xxx
	help
	  This enables support for NT36xxx driver coor x reverse.

config TOUCHSCREEN_MTK_NT36xxx_Y_REVERSE
	bool "NT36xxx driver coor y reverse"
	depends on TOUCHSCREEN_MTK_NT36xxx
	help
	  This enables support for NT36xxx driver coor y reverse.
```

## drivers/misc/mediatek/csci/Kconfig
```kconfig
config MID_CSCI_SUPPORT
        tristate "mid csci support" 
	default y
        help
          Say Y or M to enable
```

## drivers/misc/mediatek/extcon/Kconfig
```kconfig
config EXTCON_MTK_USB
	tristate "MediaTek EXTCON USB Support"
	select EXTCON
	select USB_ROLE_SWITCH
	help
	  Say Y here to enable extcon support for USB cable detection
	  on the Mediatek PMIC.

config ADAPT_CHARGER_V1
	bool "MediaTek EXTCON ADAPT_CHARGER_V1"
	help
	  Say Y here to enable ADAPT_CHARGER_V1

config USB_SWITCH_DEBUG
	bool "MediaTek EXTCON USB_SWITCH_DEBUG"
	help
	  Say Y here to enable USB_SWITCH_DEBUG
```
