&spi0 {
	status = "okay";
	chipone_tddi@0 {
		compatible = "chipone,cts";
		reg = <0>;
		spi-max-frequency = <9600000>;
		interrupt-parent = <&pio>;
		//interrupts = <65 0x2008>;
		//chipone,rst-gpio = <&pio 152 0>;
		chipone,irq-gpio = <&pio 9 0>;
		chipone,cs-gpio = <&pio 31 0>;
		chipone,x-res = <1200>;
		chipone,y-res = <1920>;
		/* Charger detect */
		
		//chipone,touch-charger-detect-enable;
		//chipone,touch-charger-detect-type = "notify"; /* notify, poll */
		//chipone,touch-charger-detect-psy-name = “charger”; /* usb */
		//chipone,touch-charger-detect-psp = "POWER_SUPPLY_PROP_ONLINE";
		//chipone,touch-charger-detect-psp-poll-interval = <1000>;
		
		/* Earjack detect */
		//chipone,touch-earjack-detect-enable;
		
		/* MTK: /sys/bus/platform/drivers/Accdet_Driver/state,
		Sprd: /sys/kernel/headset/state
		QCOM: None, and disable it */
		//chipone,touch-earjack-state-filepath ="/sys/bus/platform/drivers/Accdet_Driver/state";
		//chipone,touch-earjack-poll-interval = <1000>;
	};
};
