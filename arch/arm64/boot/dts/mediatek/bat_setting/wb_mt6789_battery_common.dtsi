#include <generated/wb_config.h>
#include <generated/autoconf.h>

#if defined(M100TB_DG_P3PRO_527)
#include "mediatek/bat_setting/M100TB_DG_P3PRO_527/mt6789_battery_prop.dtsi"
#elif defined(M100TB_TD_639)
#include "mediatek/bat_setting/M100TB_TD_639/mt6789_battery_prop.dtsi"
#elif defined(M100TB_LC_1604_WIFI)
#include "mediatek/bat_setting/M100TB_LC_1604_WIFI/mt6789_battery_prop.dtsi"
#elif defined(M100TCR100_TD_1151)
#include "mediatek/bat_setting/M100TCR100_TD_1151/mt6789_battery_prop.dtsi"
#elif defined(M100TCR100_TD_1156)
#include "mediatek/bat_setting/M100TCR100_TD_1156/mt6789_battery_prop.dtsi"
#elif defined(M100TCR100_TD_M50MINI_1236)
#include "mediatek/bat_setting/M100TCR100_TD_M50MINI_1236/mt6789_battery_prop.dtsi"
#elif defined(M100TB_JXX_1414)
#include "mediatek/bat_setting/M100TB_JXX_1414/mt6789_battery_prop.dtsi"
#elif defined(M100TB_MY_657)
#include "mediatek/bat_setting/M100TB_MY_657/mt6789_battery_prop.dtsi"
#elif defined(M100TB_JST_525)
#include "mediatek/bat_setting/M100TB_JST_525/mt6789_battery_prop.dtsi"
#elif defined(M100TB_JST_864)
#include "mediatek/bat_setting/M100TB_JST_864/mt6789_battery_prop.dtsi"
#elif defined(M100TBR210_YPD_866_WIFI)
#include "mediatek/bat_setting/M100TBR210_YPD_866_WIFI/mt6789_battery_prop.dtsi"
#elif defined(M100TBR210_GRB_964)
#include "mediatek/bat_setting/M100TBR210_GRB_964/mt6789_battery_prop.dtsi"
#elif defined(M100TBR210_GRB_1482)
#include "mediatek/bat_setting/M100TBR210_GRB_1482/mt6789_battery_prop.dtsi"
#elif defined(M100TBR210_KJ_965)
#include "mediatek/bat_setting/M100TBR210_KJ_965/mt6789_battery_prop.dtsi"
#elif defined(M100TCR100_YH_1036_WIFI)
#include "mediatek/bat_setting/M100TCR100_YH_1036_WIFI/mt6789_battery_prop.dtsi"
#elif defined(M100TCR110_CC_1341_WIFI)
#include "mediatek/bat_setting/M100TCR110_CC_1341_WIFI/mt6789_battery_prop.dtsi"
#elif defined(M100TCR110_YH_1293_WIFI)
#include "mediatek/bat_setting/M100TCR110_YH_1293_WIFI/mt6789_battery_prop.dtsi"
#elif defined(M100TBR210_DH_1089)
#include "mediatek/bat_setting/M100TBR210_DH_1089/mt6789_battery_prop.dtsi"
#elif defined(M303TBUR100_DG_P3MINI_1225) || defined(M303TBUR100_DG_P3MINI_1152) || defined(M303TBUR100_DG_P3MINI_1614)
#include "mediatek/bat_setting/M303TBUR100_DG_P3MINI_1225/mt6789_battery_prop.dtsi"
#elif defined(M169TC_YM_1275)
#include "mediatek/bat_setting/M169TC_YM_1275/mt6789_battery_prop.dtsi"
#elif defined(M127TCR100_HRA_1387_WIFI)
#include "mediatek/bat_setting/M127TCR100_HRA_1387_WIFI/mt6789_battery_prop.dtsi"
#elif defined(M100TBUR120_YK_1485) || defined(M100TBUR120_YK_1422) || defined(M100TBUR120_YK_1486)
#include "mediatek/bat_setting/M100TBUR120_YK_1485/mt6789_battery_prop.dtsi"
#elif defined(M126TBU_RMX_1557_WIFI)
#include "mediatek/bat_setting/M126TBU_RMX_1557_WIFI/mt6789_battery_prop.dtsi"
#elif defined(M126TBU_RMX_1686)
#include "mediatek/bat_setting/M126TBU_RMX_1686/mt6789_battery_prop.dtsi"
#elif defined(M100TBUER100_TD_1652)
#include "mediatek/bat_setting/M100TBUER100_TD_1652/mt6789_battery_prop.dtsi"
#elif defined(M300TCR100_MDF_1658)
#include "mediatek/bat_setting/M300TCR100_MDF_1658/mt6789_battery_prop.dtsi"
#elif defined(M100TBUER100_TD_1500)
#include "mediatek/bat_setting/M100TBUER100_TD_1500/mt6789_battery_prop.dtsi"
#elif defined(M100TBUR200_YH_1671)
#include "mediatek/bat_setting/M100TBUR200_YH_1671/mt6789_battery_prop.dtsi"
#elif defined(M131TCR100_KB_1631)
#include "mediatek/bat_setting/M131TCR100_KB_1631/mt6789_battery_prop.dtsi"
#elif defined(M108TCR100_CC_1522)
#include "mediatek/bat_setting/M108TCR100_CC_1522/mt6789_battery_prop.dtsi"
#elif defined(M100TBR210_GRB_1636)
#include "mediatek/bat_setting/M100TBR210_GRB_1636/mt6789_battery_prop.dtsi"
#elif defined(M100TBR210_YG_1585)
#include "mediatek/bat_setting/M100TBR210_YG_1585/mt6789_battery_prop.dtsi"
#elif defined(M307TBUR100_NJ_1574)
#include "mediatek/bat_setting/M307TBUR100_NJ_1574/mt6789_battery_prop.dtsi"
#else
#include "mediatek/bat_setting/M100TB_COMMON/mt6789_battery_prop.dtsi"
#endif
