## defconfig
```kconfig
# CONFIG_64BIT is not set
# CONFIG_LOCALVERSION_AUTO is not set
CONFIG_SYSVIPC=y
CONFIG_POSIX_MQUEUE=y
# CONFIG_USELIB is not set
CONFIG_AUDIT=y
CONFIG_NO_HZ=y
CONFIG_HIGH_RES_TIMERS=y
CONFIG_BSD_PROCESS_ACCT=y
CONFIG_TASKSTATS=y
CONFIG_TASK_DELAY_ACCT=y
CONFIG_TASK_XACCT=y
CONFIG_TASK_IO_ACCOUNTING=y
# CONFIG_CPU_ISOLATION is not set
CONFIG_LOG_BUF_SHIFT=18
CONFIG_CGROUPS=y
CONFIG_CGROUP_SCHED=y
CONFIG_CGROUP_FREEZER=y
CONFIG_CPUSETS=y
CONFIG_CGROUP_CPUACCT=y
CONFIG_BLK_DEV_INITRD=y
# CONFIG_COMPAT_BRK is not set
CONFIG_PROFILING=y
CONFIG_KPROBES=y
CONFIG_JUMP_LABEL=y
CONFIG_MODULES=y
CONFIG_MODULE_UNLOAD=y
CONFIG_MODULE_FORCE_UNLOAD=y
CONFIG_PARTITION_ADVANCED=y
CONFIG_BSD_DISKLABEL=y
CONFIG_MINIX_SUBPARTITION=y
CONFIG_SOLARIS_X86_PARTITION=y
CONFIG_UNIXWARE_DISKLABEL=y
CONFIG_SMP=y
# CONFIG_X86_EXTENDED_PLATFORM is not set
CONFIG_HYPERVISOR_GUEST=y
CONFIG_PARAVIRT=y
CONFIG_PARAVIRT_SPINLOCKS=y
CONFIG_X86_GENERIC=y
CONFIG_HPET_TIMER=y
CONFIG_SCHED_SMT=y
CONFIG_PREEMPT=y
CONFIG_X86_REROUTE_FOR_BROKEN_BOOT_IRQS=y
CONFIG_X86_REBOOTFIXUPS=y
# CONFIG_MICROCODE is not set
CONFIG_HIGHPTE=y
CONFIG_X86_CHECK_BIOS_CORRUPTION=y
# CONFIG_MTRR_SANITIZER is not set
CONFIG_HZ_1000=y
CONFIG_KEXEC=y
CONFIG_CRASH_DUMP=y
CONFIG_HOTPLUG_CPU=y
# CONFIG_SUSPEND is not set
# CONFIG_ACPI is not set
CONFIG_CPU_FREQ_DEFAULT_GOV_USERSPACE=y
CONFIG_PCIEPORTBUS=y
CONFIG_PCI_MSI=y
CONFIG_HOTPLUG_PCI=y
CONFIG_X86_SYSFB=y
CONFIG_BINFMT_MISC=y
CONFIG_NET=y
CONFIG_UNIX=y
CONFIG_XFRM_USER=y
CONFIG_INET=y
CONFIG_IP_MULTICAST=y
CONFIG_IP_ADVANCED_ROUTER=y
CONFIG_IP_MULTIPLE_TABLES=y
CONFIG_IP_ROUTE_MULTIPATH=y
CONFIG_IP_ROUTE_VERBOSE=y
CONFIG_IP_PNP=y
CONFIG_IP_PNP_DHCP=y
CONFIG_IP_PNP_BOOTP=y
CONFIG_IP_PNP_RARP=y
CONFIG_IP_MROUTE=y
CONFIG_IP_PIMSM_V1=y
CONFIG_IP_PIMSM_V2=y
CONFIG_SYN_COOKIES=y
# CONFIG_INET_XFRM_MODE_TRANSPORT is not set
# CONFIG_INET_XFRM_MODE_TUNNEL is not set
# CONFIG_INET_XFRM_MODE_BEET is not set
# CONFIG_INET_DIAG is not set
CONFIG_TCP_MD5SIG=y
# CONFIG_IPV6 is not set
CONFIG_VSOCKETS=y
CONFIG_VIRTIO_VSOCKETS=y
# CONFIG_WIRELESS is not set
CONFIG_NET_9P=y
CONFIG_NET_9P_VIRTIO=y
CONFIG_NET_9P_DEBUG=y
CONFIG_UEVENT_HELPER_PATH="/sbin/hotplug"
CONFIG_DEVTMPFS=y
CONFIG_DEVTMPFS_MOUNT=y
CONFIG_DEBUG_DEVRES=y
CONFIG_CONNECTOR=y
CONFIG_BLK_DEV_LOOP=y
CONFIG_VIRTIO_BLK=y
CONFIG_SCSI=y
CONFIG_BLK_DEV_SD=y
CONFIG_BLK_DEV_SR=y
CONFIG_BLK_DEV_SR_VENDOR=y
CONFIG_CHR_DEV_SG=y
CONFIG_SCSI_CONSTANTS=y
CONFIG_SCSI_SPI_ATTRS=y
# CONFIG_SCSI_LOWLEVEL is not set
CONFIG_NETDEVICES=y
CONFIG_VIRTIO_NET=y
# CONFIG_ETHERNET is not set
# CONFIG_WLAN is not set
CONFIG_INPUT_EVDEV=y
# CONFIG_LEGACY_PTYS is not set
CONFIG_SERIAL_8250=y
CONFIG_SERIAL_8250_CONSOLE=y
CONFIG_SERIAL_8250_NR_UARTS=32
CONFIG_SERIAL_8250_EXTENDED=y
CONFIG_SERIAL_8250_MANY_PORTS=y
CONFIG_SERIAL_8250_SHARE_IRQ=y
CONFIG_SERIAL_8250_DETECT_IRQ=y
CONFIG_SERIAL_8250_RSA=y
CONFIG_VIRTIO_CONSOLE=y
CONFIG_HW_RANDOM=y
CONFIG_HW_RANDOM_VIRTIO=y
# CONFIG_DEVPORT is not set
# CONFIG_HWMON is not set
CONFIG_AGP=y
CONFIG_AGP_AMD64=y
CONFIG_AGP_INTEL=y
CONFIG_DRM=y
CONFIG_DRM_QXL=y
CONFIG_DRM_BOCHS=y
CONFIG_DRM_VIRTIO_GPU=y
CONFIG_FB_MODE_HELPERS=y
CONFIG_FB_TILEBLITTING=y
CONFIG_FB_VESA=y
CONFIG_VGACON_SOFT_SCROLLBACK=y
# CONFIG_HID is not set
# CONFIG_USB_SUPPORT is not set
CONFIG_EDAC=y
CONFIG_RTC_CLASS=y
# CONFIG_RTC_HCTOSYS is not set
# CONFIG_RTC_NVMEM is not set
CONFIG_VIRT_DRIVERS=y
CONFIG_VBOXGUEST=y
CONFIG_VIRTIO_PCI=y
CONFIG_VIRTIO_BALLOON=y
CONFIG_VIRTIO_INPUT=y
CONFIG_STAGING=y
CONFIG_DRM_VBOXVIDEO=y
# CONFIG_X86_PLATFORM_DEVICES is not set
# CONFIG_IOMMU_SUPPORT is not set
CONFIG_ISO9660_FS=y
CONFIG_JOLIET=y
CONFIG_ZISOFS=y
CONFIG_PROC_KCORE=y
CONFIG_TMPFS=y
CONFIG_TMPFS_POSIX_ACL=y
CONFIG_HUGETLBFS=y
# CONFIG_MISC_FILESYSTEMS is not set
CONFIG_NFS_FS=y
CONFIG_NFS_V3_ACL=y
CONFIG_NFS_V4=y
CONFIG_ROOT_NFS=y
CONFIG_9P_FS=y
CONFIG_9P_FS_POSIX_ACL=y
CONFIG_9P_FS_SECURITY=y
CONFIG_NLS_DEFAULT="utf8"
CONFIG_NLS_CODEPAGE_437=y
CONFIG_NLS_ASCII=y
CONFIG_NLS_ISO8859_1=y
CONFIG_NLS_UTF8=y
CONFIG_PRINTK_TIME=y
# CONFIG_ENABLE_WARN_DEPRECATED is not set
# CONFIG_UNUSED_SYMBOLS is not set
CONFIG_MAGIC_SYSRQ=y
CONFIG_DEBUG_KERNEL=y
CONFIG_DEBUG_STACK_USAGE=y
CONFIG_DEBUG_STACKOVERFLOW=y
# CONFIG_SCHED_DEBUG is not set
CONFIG_SCHEDSTATS=y
CONFIG_BLK_DEV_IO_TRACE=y
CONFIG_PROVIDE_OHCI1394_DMA_INIT=y
CONFIG_EARLY_PRINTK_DBGP=y
CONFIG_DEBUG_BOOT_PARAMS=y
CONFIG_OPTIMIZE_INLINING=y
CONFIG_CRYPTO_GF128MUL=y
CONFIG_CRYPTO_SEQIV=y
# CONFIG_CRYPTO_ECHAINIV is not set
# CONFIG_CRYPTO_HW is not set
```

## drivers/comboport/Kconfig
```kconfig
# SPDX-License-Identifier: GPL-2.0
#
# Comboport devices
#

config COMBOPORT
	tristate "Combined port support (experimental)"
	help
	  Support for combined ports, that carry different (possibly optional)
	  bus types, eg. pcie, usb, sata, sim. An example are the combined
	  mpcie ports, found on tiny boards.

	  Even though standard bus channels like pcie or usb are already
	  supported by their own subsystems, there may be additional functions
	  (eg. card reset, sim channel switch, etc) and the relationship between
	  enumerated bus devices and physical cards is not clear.

	  Another typical use case are backplane cards from industrial/embedded
	  area, using different bus types altogether for one combined function.
	  Drivers or userland need to know, which logical bus devices belong to
	  one physical device.

	  Say N, unless you know you need it.

if COMBOPORT

config COMBOPORT_GENERIC
	tristate "Generic comboport platform device"
	help
	  ...

config COMBOPORT_DUMMY
	tristate "Dummy Comboport device"
	select COMBOPORT_GENERIC
	help
	  A trivial dummy comboport device driver. Just for development.

endif
```

## drivers/media/dvb-frontends/cxd2880/Kconfig
```kconfig
# SPDX-License-Identifier: GPL-2.0

config DVB_CXD2880
	tristate "Sony CXD2880 DVB-T2/T tuner + demodulator"
	depends on DVB_CORE && SPI
	select SPI_CORE_WRITE_THEN_READ
	default m if !MEDIA_SUBDRV_AUTOSELECT
	help
	  Say Y when you want to support this frontend.
```

## drivers/platform/of/Kconfig
```kconfig
# SPDX-License-Identifier: GPL-2.0-only
#
# X86 Platform Specific Drivers
#

menuconfig PLATFORM_OF_DRV
	tristate "Platform support via device tree"
	select OF
	select OF_FLATTREE
	help
	  Say Y here to get to see options for board support that's initialized
	  via compiled-in flattened device trees.

	  This is entirely independent from traditional DT-based booting (or DT
	  overlays) and meant for additional devices on non-OF-based (eg. APCI)
	  boards or composite devices behind probing-capable busses (eg. PCI).

	  Instead of writing individual drivers for just the initialization of
	  subdevices, this option provides a generic mechanism for describing
	  these devices via device tree.

	  If you say N, all options in this submenu will be skipped and disabled.

if PLATFORM_OF_DRV

config PLATFORM_OF_DRV_SYSFS_DTB
	bool "Expose device tree binaries in sysfs"
	default y
	depends on SYSFS
	help
	  Say Y here to enable exposing device tree binaries at /sys/firmware.

config PLATFORM_OF_DRV_SYSFS_DT
	bool "Expose parsed device tree in sysfs"
	default y
	depends on SYSFS
	help
	  Say Y here to enable exposing device tree nodes at
	  /sys/firmware/devicetree.

endif # PLATFORM_OF_DRV
```

## drivers/platform/x86/of/Kconfig
```kconfig
# SPDX-License-Identifier: GPL-2.0-only
#
# X86 Platform Specific Drivers
#

menuconfig X86_PLATFORM_FDT
	tristate "Device tree based board support"
	depends on X86
	help
	  Say Y here to get to see options for board support that's initialized
	  via compiled-in flattened device trees.

	  This is entirely independent from traditional DT-based booting (or DT
	  overlays) and meant for additional devices on non-OF-based (eg. APCI)
	  boards or composite devices behind probing-capable busses (eg. PCI).

	  Instead of writing individual drivers for just the initialization of
	  subdevices, this option provides a generic mechanism for describing
	  these devices via device tree.

	  If you say N, all options in this submenu will be skipped and disabled.

if X86_PLATFORM_FDT

config X86_PLATFORM_FDT_PCENGINES_APU2
	tristate "Support PC Engines APU2/3/4 mainboards"
	depends on INPUT && INPUT_KEYBOARD && GPIOLIB
	depends on LEDS_CLASS
	depends on ACPI
	select GPIO_AMD_FCH
	select KEYBOARD_GPIO_POLLED
	select LEDS_GPIO
	select OF_FLATTREE
	select OF_OVERLAY
	help
	  Say Y to enable devicetree based support for PC Engines APU2/3/4
	  mainboards. This supersedes the older pcengines-apu2 driver.

	  Supporst Gpios, front panel LEDs and front button.

endif # X86_PLATFORM_FDT
```

## drivers/portmux/Kconfig
```kconfig
# SPDX-License-Identifier: GPL-2.0
#
# Port multiplexer devices
#

config PORTMUX
	tristate "Enable the port multiplexer subsystem"
	help
	  Port multiplexers allow runtime configuration of signal routing
	  between (usually external) ports and functional units.

	  For example, some boards carry multiple SIM slots, where only
	  one at a time can be routed to the baseband.

	  The port multiplexer subsystem provides an hardware independent
	  interface for accessing querying and controlling such multiplexers
	  from userland or in-kernel drivers.

	  Note: this is very different from the 'mux' subsystem, which just
	  supports controlling mux chips as slaves by a master driver.

menu "Port multiplexer subsystem"
	depends on PORTMUX

config PORTMUX_GPIO
	tristate "GPIO-controlled port multiplexer"
	depends on GPIOLIB || COMPILE_TEST
	help
	  GPIO-controlled port multiplexer controller.

	  The driver builds a single multiplexer controller using a number
	  of gpio pins. For N pins, there will be 2^N possible multiplexer
	  states. The GPIO pins can be connected (by the hardware) to several
	  multiplexers, which in that case will be operated in parallel.

	  To compile the driver as a module, choose M here: the module will
	  be called mux-gpio.

config PORTMUX_DUMMY
	tristate "Dummy portmux driver for testing"
	default n
	help
	  Dummy portmux driver, intented for testing the portmux subsystem.

	  Unless you're hacking on the portmux subsystem, you'd most likely
	  say N here.
endmenu
```

## drivers/staging/amd-gpu/Kconfig
```kconfig
#
# Bluetooth configuration
#

menu "MXC GPU support"

config MXC_AMD_GPU
	tristate "MXC GPU support"
	depends on SOC_IMX35 || SOC_IMX51 || SOC_IMX53
	---help---
         Say Y to get the GPU driver support.

endmenu
```

## drivers/staging/p9caps/Kconfig
```kconfig
config PLAN9CAPS
	tristate "Plan 9 capability device"
	default n
	select CRYPTO_HMAC
	select CRYPTO_SHA1
	help
	  This module implements the Plan 9 capability devices
	  /dev/caphash and /dev/capuse

	  To compile this driver as a module, choose
	  M here: the module will be called p9auth.
```

## drivers/usb/misc/ti-sm-usb-dig/Kconfig
```kconfig
# SPDX-License-Identifier: GPL-2.0

config USB_TI_SM_USB_DIG
	tristate "TI SM-USB-DIG multi interface adapter"
	select I2C
	select NEW_LEDS
	select LEDS_CLASS
	select SPI
	help
	  Enables the driver for Texas Intstruments SM-USB-DIG multiple
	  interface adapter. The device provides I2C/SPI/GPIO/W1 interface
	  to connect various evaluation for TI chips.

	  The driver currently only supports I2C functionality and switching
	  DUT power (via LED).

	  To compile this driver as a module, choose M here: the
	  module will be called ti-sm-usb-dig.
```
